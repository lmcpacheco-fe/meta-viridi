## conf/layer.conf
```bitbake
# We have a conf and classes directory, add to BBPATH
BBPATH .= ":${LAYERDIR}"

# We have recipes-* directories, add to BBFILES
BBFILES += "${LAYERDIR}/recipes-*/*/*.bb \
            ${LAYERDIR}/recipes-*/*/*.bbappend"

BBFILE_COLLECTIONS += "meta-viridi"
BBFILE_PATTERN_meta-viridi = "^${LAYERDIR}/"
BBFILE_PRIORITY_meta-viridi = "6"

LAYERDEPENDS_meta-viridi = "core"
LAYERSERIES_COMPAT_meta-viridi = "langdale nickledore nanbield scarthgap walnascar"
```

## conf/machine/viridi-imx91.conf
```bitbake
#@TYPE: Machine
#@NAME: Viridi VCom Condor i.MX 91
#@SOC: i.MX91
#@DESCRIPTION: Machine configuration for NXP i.MX 91 11x11 EVK with LPDDR4
#@MAINTAINER: Aitor Carrizosa <aitor.carrizosa@futureelectronics.com>, Max Pearce Basman <max.pearce.basman@futureelectronics.com>

MACHINEOVERRIDES =. "mx91:"

require conf/machine/include/viridi-imx91.inc

KERNEL_DEVICETREE_BASENAME = "viridi-imx91"

# KERNEL_DEVICETREE:append:use-nxp-bsp = " \
#     viridi-imx91.dtb
# "

UBOOT_CONFIG_BASENAME = "viridi-imx91"

UBOOT_CONFIG ??= "sd"

DDR_FIRMWARE_NAME = " \
    lpddr4_dmem_1d_v202201.bin \
    lpddr4_dmem_2d_v202201.bin \
    lpddr4_imem_1d_v202201.bin \
    lpddr4_imem_2d_v202201.bin \
"

MACHINE_FEATURES:append = " nxpiw416-sdio"

KBUILD_DEFCONFIG = "imx_v8_defconfig"
```

## conf/machine/viridi-imx93.conf
```bitbake
#@TYPE: Machine
#@NAME: Viridi VCom Condor i.MX 93
#@SOC: i.MX93
#@DESCRIPTION: Machine configuration for NXP i.MX 93 11x11 EVK with LPDDR4X and PMIC pf0900
#@MAINTAINER: Aitor Carrizosa <aitor.carrizosa@futureelectronics.com>, Max Pearce Basman <max.pearce.basman@futureelectronics.com>

MACHINEOVERRIDES =. "mx93:"

require conf/machine/include/viridi-imx93.inc

KERNEL_DEVICETREE_BASENAME = "viridi-imx93"

# KERNEL_DEVICETREE:append:use-nxp-bsp = " \
#     viridi-imx93.dtb
# "

UBOOT_CONFIG_BASENAME = "viridi-imx93"

UBOOT_CONFIG ??= "sd"

DDR_FIRMWARE_NAME = " \
    lpddr4_dmem_1d_v202201.bin \
    lpddr4_dmem_2d_v202201.bin \
    lpddr4_imem_1d_v202201.bin \
    lpddr4_imem_2d_v202201.bin \
"

IMXBOOT_TARGETS = "${@bb.utils.contains('UBOOT_CONFIG', 'ecc', '${IMXBOOT_TARGETS_ECC}', '${IMXBOOT_TARGETS_SD}', d)}"
```
